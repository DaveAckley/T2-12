
// SPDX-License-Identifier: GPL-2.0-only
/*
 * Base device tree for BeagleBone Green as used in the T2 indefinitely scalable tile
 * 
 * Revisions Copyrignt (C) 2019 The T2 Tile Project
 * Author: Dave Ackley <ackley@ackleyshack.com>
 *
 * Based on am335x-bonegreen.dts, which is
 * Copyright (C) 2012 Texas Instruments Incorporated - http://www.ti.com/
 *
 * This program is free software; you can redistribute it and/or modify
 * it under the terms of the GNU General Public License version 2 as
 * published by the Free Software Foundation.
 */
/dts-v1/;

#include "am33xx.dtsi"
#include "am335x-bone-common.dtsi"
#include "am335x-bonegreen-common.dtsi"
/* #include "am335x-bone-jtag.dtsi" */

/ {
	model = "TI AM335x BeagleBone Green";
	compatible = "ti,am335x-bone-green", "ti,am335x-bone-black", "ti,am335x-bone", "ti,am33xx";

	chosen {
		base_dtb = "am335x-bonegreen.dts";
		base_dtb_timestamp = __TIMESTAMP__;
	};
};

&sgx {
	status = "okay";
};
